ENTRY(bootldr_main)
OUTPUT_ARCH(i386)
OUTPUT_FORMAT(binary)
SECTIONS {
	__PTR_BASE_ADDR__ = 0x00008000;
	. = __PTR_BASE_ADDR__;

	.header : {
		/*LONG(((__PTR_END_ADDR__ - __PTR_BASE_ADDR__ + 511) & ~511) / 512); - length in sectors (deprecated) */
		LONG(bootldr_main);														/* entry point */
	}

	.text : {
		*(.text)
	}

	.data BLOCK(512) : ALIGN(512) {
		*(.data)
	}

	.rodata BLOCK(512) : ALIGN(512) {
		*(.rodata)
	}

	.bss BLOCK(512) : ALIGN(512) {
		*(.bss)
	}

	.padding BLOCK(512) : ALIGN(512) {
		QUAD(0x3D3D2B2B2D2D7E7E); QUAD(0x544F4F42494B5559); QUAD(0x474E494444415020); QUAD(0x7E7E2D2D2B2B3D3D);
		QUAD(0x3D3D2B2B2D2D7E7E); QUAD(0x544F4F42494B5559); QUAD(0x474E494444415020); QUAD(0x7E7E2D2D2B2B3D3D);
		QUAD(0x3D3D2B2B2D2D7E7E); QUAD(0x544F4F42494B5559); QUAD(0x474E494444415020); QUAD(0x7E7E2D2D2B2B3D3D);
		QUAD(0x3D3D2B2B2D2D7E7E); QUAD(0x544F4F42494B5559); QUAD(0x474E494444415020); QUAD(0x7E7E2D2D2B2B3D3D);
		QUAD(0x3D3D2B2B2D2D7E7E); QUAD(0x544F4F42494B5559); QUAD(0x474E494444415020); QUAD(0x7E7E2D2D2B2B3D3D);
		QUAD(0x3D3D2B2B2D2D7E7E); QUAD(0x544F4F42494B5559); QUAD(0x474E494444415020); QUAD(0x7E7E2D2D2B2B3D3D);
		QUAD(0x3D3D2B2B2D2D7E7E); QUAD(0x544F4F42494B5559); QUAD(0x474E494444415020); QUAD(0x7E7E2D2D2B2B3D3D);
		QUAD(0x3D3D2B2B2D2D7E7E); QUAD(0x544F4F42494B5559); QUAD(0x474E494444415020); QUAD(0x7E7E2D2D2B2B3D3D);
		QUAD(0x3D3D2B2B2D2D7E7E); QUAD(0x544F4F42494B5559); QUAD(0x474E494444415020); QUAD(0x7E7E2D2D2B2B3D3D);
		QUAD(0x3D3D2B2B2D2D7E7E); QUAD(0x544F4F42494B5559); QUAD(0x474E494444415020); QUAD(0x7E7E2D2D2B2B3D3D);
		QUAD(0x3D3D2B2B2D2D7E7E); QUAD(0x544F4F42494B5559); QUAD(0x474E494444415020); QUAD(0x7E7E2D2D2B2B3D3D);
		QUAD(0x3D3D2B2B2D2D7E7E); QUAD(0x544F4F42494B5559); QUAD(0x474E494444415020); QUAD(0x7E7E2D2D2B2B3D3D);
		QUAD(0x3D3D2B2B2D2D7E7E); QUAD(0x544F4F42494B5559); QUAD(0x474E494444415020); QUAD(0x7E7E2D2D2B2B3D3D);
		QUAD(0x3D3D2B2B2D2D7E7E); QUAD(0x544F4F42494B5559); QUAD(0x474E494444415020); QUAD(0x7E7E2D2D2B2B3D3D);
		QUAD(0x3D3D2B2B2D2D7E7E); QUAD(0x544F4F42494B5559); QUAD(0x474E494444415020); QUAD(0x7E7E2D2D2B2B3D3D);
		QUAD(0x3D3D2B2B2D2D7E7E); QUAD(0x544F4F42494B5559); QUAD(0x474E494444415020); QUAD(0x7E7E2D2D2B2B3D3D);
	}

	__PTR_END_ADDR__ = .;
}